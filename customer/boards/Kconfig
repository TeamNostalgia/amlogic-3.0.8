## customer/boards/Kconfig
```kconfig
#
# Kconfig to support customer boards
#

config MACH_MESON3_F04
	depends on ARCH_MESON3
	bool "Meson3 f04 board"
	help
	  Support for Amlogic Meson3 f04 customer platform.

config MACH_MESON6_G02_D9
	depends on ARCH_MESON6
	bool "Meson6 g02 board"
	help
	  Support for Amlogic Meson6 g02_d9 customer platform.
	  
config MACH_MESON6_G02_D7
	depends on ARCH_MESON6
	bool "Meson6 g02 board"
	help
	  Support for Amlogic Meson6 g02_d7 customer platform.
	  
config MACH_MESON6_G02_TD7100
	depends on ARCH_MESON6
	bool "Meson6 g02-td7100 board"
	help
	  Support for Amlogic Meson6 g02-td7100 customer platform.
	  
config MACH_MESON6_G04
	depends on ARCH_MESON6
	bool "Meson6 g04 board"
	help
	  Support for Amlogic Meson6 g04 customer platform.

config MACH_MESON6_G04_MTC600
	depends on ARCH_MESON6
	bool "Meson6 g04_mtc600 board"
	help
	  Support for Amlogic Meson6 g04_mtc600 customer platform.

config MACH_MESON6_G04_MTC848
	depends on ARCH_MESON6
	bool "Meson6 g04_mtc848 board"
	help
	  Support for Amlogic Meson6 g04_mtc848 customer platform.

config MACH_MESON6_G04_M97
	depends on ARCH_MESON6
	bool "Meson6 g04_m97 board"
	help
	  Support for Amlogic Meson6 g04_m97 customer platform.

config MACH_MESON6_G06
	depends on ARCH_MESON6
	bool "Meson6 g06 board"
	help
	  Support for Amlogic Meson6 g06 customer platform.

config MACH_MESON6_G06_WIFI
	depends on ARCH_MESON6
	bool "Meson6 g06_usb_wifi board"
	help
	  Support for Amlogic Meson6 g06_usb_wifi customer platform.

config MACH_MESON6_G06_E3
	depends on ARCH_MESON6
	bool "Meson6 g06_e3 board"
	help
	  Support for Amlogic Meson6 g06_e3 customer platform.

config MACH_MESON6_G06_1003AC
	depends on ARCH_MESON6
	bool "Meson6 g06_1003AC board"
	help
	  Support for Amlogic Meson6 g06_1003AC customer platform.

config MACH_MESON6_G06_848
	depends on ARCH_MESON6
	bool "Meson6 g06_848 board"
	help
	  Support for Amlogic Meson6 g06_848 customer platform.
config MACH_MESON6_W28
	depends on ARCH_MESON6
	bool "Meson6 w28 board"
	help
	  Support for Amlogic Meson6 w28 customer platform.


config MACH_MESON6_G08
	depends on ARCH_MESON6
	bool "Meson6 g08 board"
	help
	  Support for Amlogic Meson6 g08 customer platform.

config MACH_MESON6_G08_768
	depends on ARCH_MESON6
	bool "Meson6 g08_768 board"
	help
	  Support for Amlogic Meson6 g08_768 customer platform.
config MACH_MESON6_G06_E4
	depends on ARCH_MESON6
	bool "Meson6 g06_e4 board"
	help
	  Support for Amlogic Meson6 g06_e4 customer platform.

config MACH_MESON6_G02
	depends on ARCH_MESON6
	bool "Meson6 g02 board"
	help
	  Support for Amlogic Meson6 g02 customer platform.

config MACH_MESON6_SOFTWIN
	depends on ARCH_MESON6
	bool "Meson6 softwin board"
	help
	  Support for Amlogic Meson6 softwin customer platform.

config MACH_MESON6_SOFTWIN_1G
	depends on ARCH_MESON6
	bool "Meson6 softwin board"
	help
	  Support for Amlogic Meson6 softwin customer platform.

config MACH_MESON6_G24
	depends on ARCH_MESON6
	bool "Meson6 g24 board"
	help
	  Support for Amlogic Meson6 g24 customer platform.

config MACH_MESON6_G24JH609
	depends on ARCH_MESON6
	bool "Meson6 g24 JH609 board"
	help
	  Support for Amlogic Meson6 g24 jinhua609 customer platform.
config MACH_MESON6_G24JH610
	depends on ARCH_MESON6
	bool "Meson6 g24 JH610 board"
	help
	  Support for Amlogic Meson6 g24 jinhua610 customer platform.
	  
config MACH_MESON6_G24YD607
	depends on ARCH_MESON6
	bool "Meson6 g24 YIDA 607 board"
	help
	  Support for Amlogic Meson6 g24 yida 607 customer platform.

config MACH_MESON6_G24HTC001
	depends on ARCH_MESON6
	bool "Meson6 g24 HTC 001 board"
	help
	  Support for Amlogic Meson6 g24 htc 001 customer platform.
config MACH_MESON6_G24_GEMEI_K8
	depends on ARCH_MESON6
	bool "Meson6 g24_K8 board"
	help
	  Support for Amlogic Meson6 g24_K8 customer platform.
	  
config MACH_MESON6_G24G9TM
	depends on ARCH_MESON6
	bool "Meson6 g24G9TM board"
	help
	  Support for Amlogic Meson6 g24G9TM customer platform.
	  
config MACH_MESON6_G24_86V
	depends on ARCH_MESON6
	bool "Meson6 g24_86V board"
	help
	  Support for Amlogic Meson6 g24_86V customer platform.

config MACH_MESON6_G24_86V2
	depends on ARCH_MESON6
	bool "Meson6 86V2 board"
	help
	  Support for Amlogic Meson6 86V2 customer platform.
	  
config MACH_MESON6_G34
	depends on ARCH_MESON6
	bool "Meson6 86V4 board"
	help
	  Support for Amlogic Meson6 g34 malata customer platform.

config MACH_MESON6_G33_NEW
	depends on ARCH_MESON6
	bool "Meson6 86V4 board"
	help
	  Support for Amlogic MXL g33 512M platform ,which use SDIO WIFI and with HDMI.

config MACH_MESON6_G33_NEW1G
	depends on ARCH_MESON6
	bool "Meson6 86V4 board"
	help
	  Support for Amlogic MXS g33 1G platform ,which use SDIO WIFI and with HDMI.
	  
config MACH_MESON6_G33_1212NEW
	depends on ARCH_MESON6
	bool "Meson6 g33 with AM1212New board"
	help
	  Support for Amlogic Meson6 g33 with AM1212 New customer platform.
	  
config MACH_MESON6_G24_K8
	depends on ARCH_MESON6
	bool "Meson6 g24_k8 board"
	help
	  Support for Amlogic Meson6 g24_k8 customer platform.

config MACH_MESON6_G24_M8316CM
	depends on ARCH_MESON6
	bool "Meson6 g24_M8316CM board"
	help
	  Support for Amlogic Meson6 g24_M8316CM customer platform.

config MACH_MESON6_G24_M7316CM
	depends on ARCH_MESON6
	bool "Meson6 g24_M7316CM board"
	help
	  Support for Amlogic Meson6 g24_M7316CM customer platform.

config MACH_MESON6_G24_M7317CM
	depends on ARCH_MESON6
	bool "Meson6 g24_M7317CM board"
	help
	  Support for Amlogic Meson6 g24_M7317CM customer platform.
	  
config MACH_MESON6_G24_M8306CM
	depends on ARCH_MESON6
	bool "Meson6 g24_M8306CM board"
	help
	  Support for Amlogic Meson6 g24_M8306CM customer platform.

config MACH_MESON6_G24_M9308CM
	depends on ARCH_MESON6
	bool "Meson6 g24_M9308CM board"
	help
	  Support for Amlogic Meson6 g24_M9308CM customer platform.
	  
config MACH_MESON6_G24_M9306CM
	depends on ARCH_MESON6
	bool "Meson6 g24_M9306CM board"
	help
	  Support for Amlogic Meson6 g24_M9306CM customer platform.

config MACH_MESON6_G24_512
	depends on ARCH_MESON6
	bool "Meson6 g24 512M  board"
	help
	  Support for Amlogic Meson6 g24 512 customer platform.

config MACH_MESON6_G14
	depends on ARCH_MESON6
	bool "Meson6 g14 board"
	help
	  Support for Amlogic Meson6 g14 customer platform.

config VIDEO_AMLOGIC_CAPTURE_GC2015_front
	depends on ARCH_MESON6
	bool "VIDEO_AMLOGIC_CAPTURE_GC2015_front"
	help
	  Support for Amlogic Meson6 g12 M1005 customer platform.
	  
config MACH_MESON6_G12_M1005
	depends on ARCH_MESON6
	bool "Meson6 g12 M1005 board"
	help
	  Support for Amlogic Meson6 g12 M1005 customer platform.
	  
	  
config MACH_MESON6_G12_M805
	depends on ARCH_MESON6
	bool "Meson6 g12 M805 board"
	help
	  Support for Amlogic Meson6 g12 M805 customer platform.

config MACH_MESON6_G12_M805RO
	depends on ARCH_MESON6
	bool "Meson6 g12 M805RO board"
	help
	  Support for Amlogic Meson6 g12 M805RO customer platform.

config MACH_MESON6_G12_M1005RUPR
	depends on ARCH_MESON6
	bool "Meson6 g12 M1005RUPR board"
	help
	  Support for Amlogic Meson6 g12 M1005RUPR customer platform.

config MACH_MESON6_G12_M1005GEN
	depends on ARCH_MESON6
	bool "Meson6 g12 M1005GEN board"
	help
	  Support for Amlogic Meson6 g12 M1005GEN customer platform.

config MACH_MESON6_G12_M1006
	depends on ARCH_MESON6
	bool "Meson6 g12 M1006 board"
	help
	  Support for Amlogic Meson6 g12 M1006 customer platform.

config MACH_MESON6_G12_M1006A2
	depends on ARCH_MESON6
	bool "Meson6 g12 M1006A2 board"
	help
	  Support for Amlogic Meson6 g12 M1006A2 customer platform.

config MACH_MESON6_G12_M1006AG2BL
	depends on ARCH_MESON6
	bool "Meson6 g12 M1006AG2BL board"
	help
	  Support for Amlogic Meson6 g12 M1006AG2BL customer platform.
	  
config MACH_MESON6_G12_M1006RU
	depends on ARCH_MESON6
	bool "Meson6 g12 M1006RU board"
	help
	  Support for Amlogic Meson6 g12 M1006RU customer platform.

config MACH_MESON6_G12_M1006RO
	depends on ARCH_MESON6
	bool "Meson6 g12 M1006RO board"
	help
	  Support for Amlogic Meson6 g12 M1006RO customer platform.

config MACH_MESON6_G12_M1006PEARL
	depends on ARCH_MESON6
	bool "Meson6 g12 M1006PEARL board"
	help
	  Support for Amlogic Meson6 g12 M1006PEARL customer platform.

config MACH_MESON6_G12_M1006PT
	depends on ARCH_MESON6
	bool "Meson6 g12 M1006PT board"
	help
	  Support for Amlogic Meson6 g12 M1006PT customer platform.

config MACH_MESON6_G12_M1006AG1
	depends on ARCH_MESON6
	bool "Meson6 g12 M1006AG1 board"
	help
	  Support for Amlogic Meson6 g12 M1006AG1 customer platform.

config MACH_MESON6_G12_M1006DM
	depends on ARCH_MESON6
	bool "Meson6 g12 M1006DM board"
	help
	  Support for Amlogic Meson6 g12 M1006DM customer platform.

config MACH_MESON6_G12_M1006A2DM
	depends on ARCH_MESON6
	bool "Meson6 g12 M1006A2DM board"
	help
	  Support for Amlogic Meson6 g12 M1006A2DM customer platform.
	  
config MACH_MESON6_G12_M1006AG1DM
	depends on ARCH_MESON6
	bool "Meson6 g12 M1006AG1 board"
	help
	  Support for Amlogic Meson6 g12 M1006AG1DM customer platform.
	  
config MACH_MESON6_G12_M1006AG2DM
	depends on ARCH_MESON6
	bool "Meson6 g12 M1006AG2DM board"
	help
	  Support for Amlogic Meson6 g12 M1006AG2DM customer platform.

config MACH_MESON6_G12_M1006AG2GEN
	depends on ARCH_MESON6
	bool "Meson6 g12 M1006AG2GEN board"
	help
	  Support for Amlogic Meson6 g12 M1006AG2GEN customer platform.

config MACH_MESON6_G12_M1006A2GEN
	depends on ARCH_MESON6
	bool "Meson6 g12 M1006A2GEN board"
	help
	  Support for Amlogic Meson6 g12 M1006A2GEN customer platform.
	  
config MACH_MESON6_G12_M802A1
	depends on ARCH_MESON6
	bool "Meson6 g12 M802A1 board"
	help
	  Support for Amlogic Meson6 g12 M802A1 customer platform.
	  
config MACH_MESON6_G12_M803A1
	depends on ARCH_MESON6
	bool "Meson6 g12 M803A1 board"
	help
	  Support for Amlogic Meson6 g12 M803A1 customer platform.	  

config MACH_MESON6_G12_M806A1
	depends on ARCH_MESON6
	bool "Meson6 g12 M806A1 board"
	help
	  Support for Amlogic Meson6 g12 M806A1 customer platform.

config MACH_MESON6_G12_M806A1PEARL
	depends on ARCH_MESON6
	bool "Meson6 g12 M806A1PEARL board"
	help
	  Support for Amlogic Meson6 g12 M806A1PEARL customer platform.

config MACH_MESON6_G12_M806A2
	depends on ARCH_MESON6
	bool "Meson6 g12 M806A2 board"
	help
	  Support for Amlogic Meson6 g12 M806A2 customer platform.

config MACH_MESON6_G12_M806A5
	depends on ARCH_MESON6
	bool "Meson6 g12 M806A5 board"
	help
	  Support for Amlogic Meson6 g12 M806A5 customer platform.

config MACH_MESON6_G12_M1006A5
	depends on ARCH_MESON6
	bool "Meson6 g12 M806A5 board"
	help
	  Support for Amlogic Meson6 g12 M1006A5 customer platform.
	  
config MACH_MESON6_G12_M806A2RU
	depends on ARCH_MESON6
	bool "Meson6 g12 M806A2RU board"
	help
	  Support for Amlogic Meson6 g12 M806A2RU customer platform.

config VIDEO_AMLOGIC_CAPTURE_GC0307_front
	depends on ARCH_MESON6
	bool "Meson6 g12 M806A2RU board"
	help
		Support for Amlogic Meson6 g12 M806A2RU customer platform.

config MACH_MESON6_G12_M806A2ODYS
	depends on ARCH_MESON6
	bool "Meson6 g12 M806A2ODYS board"
	help
	  Support for Amlogic Meson6 g12 M806A2ODYS customer platform.

config MACH_MESON6_G12_M806A1SPIGEN
	depends on ARCH_MESON6
	bool "Meson6 g12 M806A1SPIGEN board"
	help
	  Support for Amlogic Meson6 g12 M806A1SPIGEN customer platform.

config MACH_MESON6_G12_M809A1
	depends on ARCH_MESON6
	bool "Meson6 g12 M809A1 board"
	help
	  Support for Amlogic Meson6 g12 M809A1 customer platform.

config MACH_MESON6_G12_M809A2
	depends on ARCH_MESON6
	bool "Meson6 g12 M809A2 board"
	help
	  Support for Amlogic Meson6 g12 M809A2 customer platform.
	  
config MACH_MESON6_G12_M978A1
	depends on ARCH_MESON6
	bool "Meson6 g12 M978A1 board"
	help
	  Support for Amlogic Meson6 g12 M978A1 customer platform.

config MACH_MESON6_G12_M701A1
	depends on ARCH_MESON6
	bool "Meson6 g12 M701A1 board"
	help
	  Support for Amlogic Meson6 g12 M701A1 customer platform.

config MACH_MESON6_G12_M702A1
	depends on ARCH_MESON6
	bool "Meson6 g12 M702A1 board"
	help
	  Support for Amlogic Meson6 g12 M702A1 customer platform.

config MACH_MESON6_G12_M702A2
	depends on ARCH_MESON6
	bool "Meson6 g12 M702A2 board"
	help
	  Support for Amlogic Meson6 g12 M702A2 customer platform.

config MACH_MESON6_G12_M705A5
	depends on ARCH_MESON6
	bool "Meson6 g12 M705A5 board"
	help
	  Support for Amlogic Meson6 g12 M705A5 customer platform.

config MACH_MESON6_G12_M709A5
	depends on ARCH_MESON6
	bool "Meson6 g12 M709A5 board"
	help
	  Support for Amlogic Meson6 g12 M709A5 customer platform.

config MACH_MESON6_G12_M701A5
	depends on ARCH_MESON6
	bool "Meson6 g12 M701A5 board"
	help
	  Support for Amlogic Meson6 g12 M701A5 customer platform.

config MACH_MESON6_G12_M702A5
	depends on ARCH_MESON6
	bool "Meson6 g12 M702A5 board"
	help
	  Support for Amlogic Meson6 g12 M702A5 customer platform.

config MACH_MESON6_G12_M702A5DM
	depends on ARCH_MESON6
	bool "Meson6 g12 M702A5DM board"
	help
	  Support for Amlogic Meson6 g12 M702A5DM customer platform.
	  
config MACH_MESON6_G12_M704A1
	depends on ARCH_MESON6
	bool "Meson6 g12 M704A1 board"
	help
	  Support for Amlogic Meson6 g12 M704A1 customer platform.

config MACH_MESON6_G12_M704A1RU
	depends on ARCH_MESON6
	bool "Meson6 g12 M704A1RU board"
	help
	  Support for Amlogic Meson6 g12 M704A1RU customer platform.

config MACH_MESON6_G12_M704A1RO
	depends on ARCH_MESON6
	bool "Meson6 g12 M704A1RO board"
	help
	  Support for Amlogic Meson6 g12 M704A1RO customer platform.

config MACH_MESON6_G12_M708A1
	depends on ARCH_MESON6
	bool "Meson6 g12 M708A1 board"
	help
	  Support for Amlogic Meson6 g12 M708A1 customer platform.

config MACH_MESON6_G12_M708A2
	depends on ARCH_MESON6
	bool "Meson6 g12 M708A2 board"
	help
	  Support for Amlogic Meson6 g12 M708A2 customer platform.

config MACH_MESON6_G12_M1005SPI
	depends on ARCH_MESON6
	bool "Meson6 g12 M1005SPI board"
	help
	  Support for Amlogic Meson6 g12 M1005SPI customer platform.

config MACH_MESON6_G11_E8
	depends on ARCH_MESON6
	bool "Meson6 g11_e8 board"
	help
	  Support for Amlogic Meson6 g11_e8 customer platform.

config TC103
	depends on MACH_MESON6_G11_E8
	bool "tc103 config for g11 e8 bsp"
	help
	  config tc103 for g11 e8
      
config MACH_MESON6_G11_E8HDS
	depends on ARCH_MESON6
	bool "Meson6 g11e8hds board"
	help
	  Support for Amlogic Meson6 g11e8hds customer platform.
      
config MACH_MESON6_G11_N8
	depends on ARCH_MESON6
	bool "Meson6 g11_n8 board"
	help
	  Support for Amlogic Meson6 g11_n8 customer platform.

config MACH_MESON6_G05_N10A
	depends on ARCH_MESON6
	bool "Meson6 g05-n10a board"
	help
	  Support for Amlogic Meson6 g05-n10a customer platform.

config MACH_MESON6_G05_N97A
	depends on ARCH_MESON6
	bool "Meson6 g05-n97a board"
	help
	  Support for Amlogic Meson6 g05-n97a customer platform.

config MACH_MESON6_G05_N97AX190
	depends on ARCH_MESON6
	bool "Meson6 g05-n97ax190 board"
	help
	  Support for Amlogic Meson6 g05-n97ax190 customer platform.

config MACH_MESON6_G05_M76
	depends on ARCH_MESON6
	bool "Meson6 g05-m76 board"
	help
	  Support for Amlogic Meson6 g05-m76 customer platform.

config MACH_MESON6_G05_S5V4
	depends on ARCH_MESON6
	bool "Meson6 g05-S5V4 board"
	help
	  Support for Amlogic Meson6 g05-S5V4 customer platform.

config MACH_MESON6_G05_86C
	depends on ARCH_MESON6
	bool "Meson6 g05-86C board"
	help
	  Support for Amlogic Meson6 g05-86C customer platform.

      
config MACH_MESON6_G22
	depends on ARCH_MESON6
	bool "Meson6 g22 board"
	help
	  Support for Amlogic Meson6 g22 customer platform.

config MACH_MESON6_G30_N87A
	depends on ARCH_MESON6
	bool "Meson6 g30 N87A MXL board"
	help
	  Support for Amlogic Meson6 g30 n87a MXL 512M customer platform.


config MACH_MESON6_G30_S10A
	depends on ARCH_MESON6
	bool "Meson6 S10A MXL board"
	help
	  Support for Amlogic Meson6 g30 S10A MXL 1G customer platform.

config MACH_MESON6_G30_N79A
	depends on ARCH_MESON6
	bool "Meson6 g30 N79A board"
	help
	  Support for Amlogic Meson6 g30 n79a customer platform.

config MACH_MESON6_G30_N77A
	depends on ARCH_MESON6
	bool "Meson6 g30 N77A board"
	help
	  Support for Amlogic Meson6 g30 n77a customer platform.

config MACH_MESON6_G06_N77A
	depends on ARCH_MESON6
	bool "Meson6 g06 N77A board"
	help
	  Support for Amlogic Meson6 g12 M704A1 customer platform.
	  
config MACH_MESON6_G17_T102
	depends on ARCH_MESON6
	bool "Meson6 g17_t102 board"
	help
	  Support for Amlogic Meson6 g17_t069 customer platform.	  

	  
config MACH_MESON6_G05_N1B
	depends on ARCH_MESON6
	bool "Meson6 g05-n1b board"
	help
	  Support for Amlogic Meson6 g05-n1b customer platform.

config MACH_MESON6_G04_MTC8723
	depends on ARCH_MESON6
	bool "Meson6 g04_mtc8723 board"
	help
	  Support for Amlogic Meson6 g04_mtc8723 customer platform.

config MACH_MESON6_G05_N97AB
	depends on ARCH_MESON6
	bool "Meson6 g05-n97ab board"
	help
	  Support for Amlogic Meson6 g05-n97ab customer platform.
	  
config MACH_MESON6_G17_M1703
	depends on ARCH_MESON6
	bool "Meson6 g17_m1703 board"
	help
	  Support for Amlogic Meson6 g17_m1703 customer platform.	  

config MACH_MESON6_G17_M1801
	depends on ARCH_MESON6
	bool "Meson6 g17_m1801 board"
	help
	  Support for Amlogic Meson6 g17_m1801 customer platform.	  

config MACH_MESON6_W17
  depends on ARCH_MESON6
  bool "Meson6 w17 board"
  help
    Support for Amlogic Meson6 w17 customer platform.

config MACH_MESON6_G38
	depends on ARCH_MESON6
	bool "Meson6 g38 board"
	help
	  Support for Amlogic Meson6 g38 customer platform.

config MACH_MESON6_G38_T97203
	depends on ARCH_MESON6
	bool "Meson6 g38-t97203 board"
	help
	  Support for Amlogic Meson6 g38_t97203 customer platform.

config MACH_MESON6_G04_MTC1280
	depends on ARCH_MESON6
	bool "Meson6 g04_mtc1280 board"
	help
	  Support for Amlogic Meson6 g04_mtc1280 customer platform.

config MACH_MESON6_G04_MTC600_10D
	depends on ARCH_MESON6
	bool "Meson6 g04_mtc600_10d board"
	help
	  Support for Amlogic Meson6 g04_mtc600_10d customer platform.

config MACH_MESON6_G04_MTC600_10D8723
	depends on ARCH_MESON6
	bool "Meson6 g04_mtc600_10d8723 board"
	help
	  Support for Amlogic Meson6 g04_mtc600_10d customer platform.

config MACH_MESON6_G04_MTC1280_8723
	depends on ARCH_MESON6
	bool "Meson6 g04_mtc1280_8723 board"
	help
	  Support for Amlogic Meson6 g04_mtc1280_8723 customer platform.
	  
config MACH_MESON6_ROADA15
	depends on ARCH_MESON6
	bool "Meson6 Road A15 board"
	help
	  Support for Amlogic Meson6 Road A15 customer platform.

config MACH_MESON6_ROCOREF
	depends on ARCH_MESON6
	bool "Meson6 roco ref board"
	help
	  Support for Amlogic Meson6 roco ref customer platform.	  

config MACH_MESON6_G24_K10
        depends on ARCH_MESON6
        bool "Meson6 g24 K10 board"
        help
          Support for Amlogic Meson6 g24 K10 customer platform.

config MACH_MESON6_G38_T10203
	depends on ARCH_MESON6
	bool "Meson6 g38-t10203 board"
	help
	  Support for Amlogic Meson6 g38_t10203 customer platform.

config MACH_MESON6_G08_MID9765
        depends on ARCH_MESON6
        bool "Meson6 g08_MID9765 board"
        help
          Support for Amlogic Meson6 g08 MID9765 customer platform.
	  
	  
config MACH_MESON6_G38_T7203
	depends on ARCH_MESON6
	bool "Meson6 g38-t7203 board"
	help
	  Support for Amlogic Meson6 g38_t7203 customer platform.


config MACH_MESON6_G05_S9V5
	depends on ARCH_MESON6
	bool "Meson6 g05-S9V5 board"
	help
	  Support for Amlogic Meson6 g05-S9V5 customer platform.

config MACH_MESON6_G05_S9V5EN
	depends on ARCH_MESON6
	bool "Meson6 g05-S9V5EN board"
	help
	  Support for Amlogic Meson6 g05-S9V5EN customer platform.
	  
config MACH_MESON6_G30_N72A
	depends on ARCH_MESON6
	bool "Meson6 g30 N72A board"
	help
	  Support for Amlogic Meson6 g30 n72a customer platform.

config MACH_MESON6_G30_N72AHD
	depends on ARCH_MESON6
	bool "Meson6 g30 N72AHD board"
	help
	  Support for Amlogic Meson6 g30 n72ahd customer platform.
	  
config MACH_MESON6_G33_FUGE512
	depends on ARCH_MESON6
	bool "Meson6 86V4 fuge board"
	help
	  Support for Amlogic Meson6 g33 86V4 fuge customer platform ,which use usb WIFI and with HDMI.
	  
config MACH_MESON6_G33_FUGE512_848
	depends on ARCH_MESON6
	bool "Meson6 86V4 fuge 512 848 board"
	help
	  Support for Amlogic Meson6 g33 86V4 fuge customer platform ,which use usb WIFI and with HDMI.

config MACH_MESON6_G33_FUGE512CAMERA
	depends on ARCH_MESON6
	bool "Meson6 86V4 fuge camera board"
	help
	  Support for Amlogic Meson6 g33 86V4 fuge customer platform ,which use usb WIFI and with HDMI.
	  
config MACH_MESON6_G33_FUGE512CAMERA_848
	depends on ARCH_MESON6
	bool "Meson6 86V4 fuge 512 848 camera board"
	help
	  Support for Amlogic Meson6 g33 86V4 fuge customer platform ,which use usb WIFI and with HDMI.
config MACH_MESON6_G33_FUGE512_DC_848
	depends on ARCH_MESON6
	bool "Meson6 86V4 fuge 512 848 double camera board"
	help
	  Support for Amlogic Meson6 g33 86V4 fuge customer platform ,which use usb WIFI and with HDMI.

config MACH_MESON6_GT7260
        depends on ARCH_MESON6
        bool "Meson6 gt7260 board"
        help
          Support for Amlogic Meson6 gt7260 customer platform.
	  	  
config MACH_MESON6_G27_MTC600
	depends on ARCH_MESON6
	bool "Meson6 g27_mtc600 board"
	help
	  Support for Amlogic Meson6 g27_mtc600 customer platform.

config MACH_MESON6_G33_FUGE1G
	depends on ARCH_MESON6
	bool "Meson6 86V4 fuge 1G board"
	help
	  Support for Amlogic Meson6 g33 86V4 fuge customer platform ,which use usb WIFI and with HDMI.

config MACH_MESON6_G33_FUGE1G_HK
	depends on ARCH_MESON6
	bool "Meson6 86V4 fuge 1G hk board"
	help
	  Support for Amlogic Meson6 g33 86V4 fuge customer platform ,which use sdio WIFI AP6210 and with HDMI.
	  
config MACH_MESON6_G33_FUGE1G_848
	depends on ARCH_MESON6
	bool "Meson6 86V4 fuge 1G 848 board"
	help
	  Support for Amlogic Meson6 g33 86V4 fuge customer platform ,which use usb WIFI and with HDMI.

config MACH_MESON6_G13_SP0738J
	depends on ARCH_MESON6
	bool "Meson6 g13SP0738J MXL board"
	help
	  Support for Amlogic Meson6 g12SP0738J MXL 1G customer platform.

config MACH_MESON6_G12_M1006AG2SY
	depends on ARCH_MESON6
	bool "Meson6 g12 M1006AG2SY board"
	help
	  Support for Amlogic Meson6 g12 M1006AG2SY customer platform.	  

config MACH_MESON6_G30_N79AMID
	depends on ARCH_MESON6
	bool "Meson6 g33refN79AMID MXL board"
	help
	  Support for Amlogic Meson6 g33refN79AMID MXL 1G customer platform.
```
